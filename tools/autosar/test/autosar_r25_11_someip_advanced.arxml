AUTOSAR XML (schema 00054)
standard types defined: uint8, uint16, uint32
package /Advanced/PlatformTypes
  base type Utf8: category=VARIABLE_LENGTH, base-type-size=8, base-type-encoding=UTF-8
  base type Utf16: category=VARIABLE_LENGTH, base-type-size=16, base-type-encoding=UTF-16
package /Advanced/ImplementationTypes
  6 x impl type:
    Lookup: category=ASSOCIATIVE_MAP
      element key: category=VALUE, base-type=uint16
      element value: category=VALUE, base-type=uint32
    Choice: category=UNION
      element small: category=VALUE, base-type=uint16
      element large: category=VALUE, base-type=uint32
    Cube: category=ARRAY
      element plane: category=ARRAY, array-size=2, array-size-semantics=FIXED-SIZE
        element row: category=ARRAY, array-size=2, array-size-semantics=FIXED-SIZE
          element cell: category=VALUE, array-size=2, array-size-semantics=FIXED-SIZE, base-type=uint8
    RecordArray: category=ARRAY
      element record: category=STRUCTURE, array-size=2, array-size-semantics=FIXED-SIZE
        element value: category=VALUE, base-type=uint8
    AdvancedPayload: category=STRUCTURE
      4 x element:
        title: category=STRING, sw-text-props={sw-max-text-size=4, base-type=Utf16}
        lookup: implementation-data-type=Lookup
        samples: category=VALUE, array-size=2, array-size-semantics=VARIABLE-SIZE, base-type=uint16
        choice: implementation-data-type=Choice
    TlvPayload: category=STRUCTURE
      5 x element:
        label: category=STRING, is-optional=true, sw-text-props={sw-max-text-size=4, base-type=Utf8}
        code: category=VALUE, base-type=uint8
        lookup: is-optional=true, implementation-data-type=Lookup
        values: is-optional=true, implementation-data-type=Cube
        records: is-optional=true, implementation-data-type=RecordArray
package /Advanced/ServiceInterfaces
  service interface AdvancedService
    events:
      data Event: type=AdvancedPayload
      data TlvEvent: type=TlvPayload
package /Advanced/SomeipDeployment
  tlv data id definition set TlvDataIds
    tlv-data-id-definitions:
      id=1, tlv-implementation-data-type-element=label
      id=2, tlv-implementation-data-type-element=code
      id=3, tlv-implementation-data-type-element=TlvPayload/lookup
      id=4, tlv-implementation-data-type-element=values
      id=5, tlv-implementation-data-type-element=records
  transformation props set AdvancedTransformationProps
    ap someip transformation props Defaults: size-of-array-length-field=2, size-of-string-length-field=2, size-of-struct-length-field=2, size-of-union-length-field=2, size-of-union-type-selector-field=1, string-encoding=UTF-16BE
    ap someip transformation props TlvDefaults: size-of-array-length-field=2, size-of-string-length-field=2, size-of-struct-length-field=2, size-of-union-length-field=2
  transformation props to service interface element mapping EventMapping: event=Event, transformation-props=Defaults
  transformation props to service interface element mapping TlvEventMapping: event=TlvEvent, tlv-data-id-definition=TlvDataIds, transformation-props=TlvDefaults
