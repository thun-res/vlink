AUTOSAR XML (schema 00054)
standard types defined: uint8, uint16
package /Matrix/PlatformTypes
  base type Utf8: category=VARIABLE_LENGTH, base-type-size=8, base-type-encoding=UTF-8
package /Matrix/ImplementationTypes
  impl type SimplePayload: category=STRUCTURE
    4 x element:
      sequence: category=VALUE, base-type=uint16
      name: category=STRING, sw-text-props={sw-max-text-size=4, base-type=Utf8}
      values: category=ARRAY, array-size=4, array-size-semantics=VARIABLE-SIZE, base-type=uint8
      tail: category=VALUE, base-type=uint16
package /Matrix/ServiceInterfaces
  service interface MatrixService
    events:
      data SimpleEvent: type=SimplePayload
package /Matrix/SomeipDeployment
  transformation props set MatrixTransformationProps
    ap someip transformation props MatrixDefaults: alignment=8, byte-order=big-endian, size-of-array-length-field=1, size-of-string-length-field=1, size-of-struct-length-field=1
  transformation props to service interface element mapping SimpleEventMapping: event=SimpleEvent, transformation-props=MatrixDefaults
