AUTOSAR XML (schema 4.0)
standard types defined: uint8, uint16
package /Features
  base type Utf8: base-type-size=8, base-type-encoding=UTF-8
  base type Utf16: base-type-size=16, base-type-encoding=UTF-16
  app type Text8: category=STRING, sw-text-props={array-size-semantics=FIXED-SIZE, sw-max-text-size=4, base-type=Utf8}
  app type Text16: category=STRING, sw-text-props={array-size-semantics=FIXED-SIZE, sw-max-text-size=3, base-type=Utf16}
  impl type Text8Storage: category=ARRAY
    element element: category=VALUE, array-size=8, array-size-semantics=FIXED-SIZE, base-type=uint8
  impl type Text16Storage: category=ARRAY
    element element: category=VALUE, array-size=4, array-size-semantics=FIXED-SIZE, base-type=uint16
  application record data type Payload
    application record element text8: type=Text8
    application record element text16: type=Text16
  application record data type TlvPayload
    application record element text8: type=Text8
    application record element text16: type=Text16
  application record data type StaticTlvPayload
    application record element text8: type=Text8
  data type mapping set Mappings
    data-type-maps:
      application-data-type=Text8, implementation-data-type=Text8Storage
      application-data-type=Text16, implementation-data-type=Text16Storage
  service interface Service
    events:
      data Event: type=Payload
      data TlvEvent: type=TlvPayload
      data StaticTlvEvent: type=StaticTlvPayload
  tlv data id definition set TlvDataIds
    tlv-data-id-definitions:
      id=1, tlv-record-element=TlvPayload/text8
      id=2, tlv-record-element=TlvPayload/text16
      id=1, tlv-record-element=StaticTlvPayload/text8
  transformation props set Props
    ap someip transformation props Deployment: size-of-string-length-field=1
    ap someip transformation props TlvDeployment: size-of-string-length-field=1, size-of-struct-length-field=1
    ap someip transformation props StaticTlvDeployment: is-dynamic-length-field-size=false, size-of-string-length-field=1, size-of-struct-length-field=1
  transformation props to service interface element mapping Mapping: event=Event, transformation-props=Deployment
  transformation props to service interface element mapping TlvMapping: event=TlvEvent, tlv-data-id-definition=TlvDataIds, transformation-props=TlvDeployment
  transformation props to service interface element mapping StaticTlvMapping: event=StaticTlvEvent, tlv-data-id-definition=TlvDataIds, transformation-props=StaticTlvDeployment
