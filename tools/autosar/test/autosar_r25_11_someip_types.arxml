AUTOSAR XML (schema 00054)
standard types defined: boolean, float32, sint32, uint8, uint16, uint32
package /AUTOSAR/PlatformTypes
  6 x app type:
    boolean: category=BOOLEAN
    float32: category=FLOAT32
    sint32: category=SINT32
    uint8: category=UINT8
    uint16: category=UINT16
    uint32: category=UINT32
package /VLink/PlatformTypes
  base type Utf8: category=VARIABLE_LENGTH, base-type-size=8, base-type-encoding=UTF-8
package /VLink/ImplementationTypes
  6 x impl type:
    GearMode: category=VALUE, base-type=uint8, compu {0=park, 1=drive, 2=reverse}
    Position: category=STRUCTURE
      element x: category=VALUE, base-type=sint32
      element y: category=VALUE, base-type=sint32
    SampleWindow: category=ARRAY
      element element: category=VALUE, array-size=4, array-size-semantics=FIXED-SIZE, base-type=uint16
    ObjectList: category=ARRAY
      element element: array-size=2, array-size-semantics=VARIABLE-SIZE, implementation-data-type=Position
    PayloadBytes: category=ARRAY
      element element: category=VALUE, array-size=4, array-size-semantics=VARIABLE-SIZE, base-type=uint8
    VehicleState: category=STRUCTURE
      10 x element:
        sequence: category=VALUE, base-type=uint32
        valid: category=VALUE, base-type=boolean
        mode: implementation-data-type=GearMode
        temperature: category=VALUE, base-type=float32
        name: category=STRING, sw-text-props={sw-max-text-size=7, base-type=Utf8}
        position: implementation-data-type=Position
        samples: implementation-data-type=SampleWindow
        objects: implementation-data-type=ObjectList
        payload: implementation-data-type=PayloadBytes
        matrix: category=ARRAY, array-size=2, array-size-semantics=FIXED-SIZE
          element row: category=ARRAY, array-size=3, array-size-semantics=FIXED-SIZE
            element cell: category=VALUE, base-type=uint16
package /VLink/ServiceInterfaces
  constant specification InitialSequence: value-spec=7
  service interface VehicleStateService
    events:
      data VehicleStateEvent: type=VehicleStateApplication, init-value=fields=[InitialSequence, true, drive, 20.5, parked, fields=[-5, 8], [10, 20, 30, 40], [fields=[1, 2], fields=[-3, 4]], [0xDE, 0xAD, 0xBE, 0xEF], [[1, 2, 3], [4, 5, 6]]]
package /VLink/ApplicationTypes
  app type VehicleNameApplication: category=STRING
  application record data type PositionApplication: category=STRUCTURE
    application record element x: category=VALUE, type=sint32
    application record element y: category=VALUE, type=sint32
  5 x application array data type, all with category=ARRAY:
    SampleWindowApplication
      element element: category=VALUE, type=uint16, array-size-semantics=FIXED-SIZE, max-number-of-elements=4
    ObjectListApplication
      element element: category=TYPE_REFERENCE, type=PositionApplication, array-size-semantics=VARIABLE-SIZE, max-number-of-elements=2
    PayloadBytesApplication
      element element: category=VALUE, type=uint8, array-size-semantics=VARIABLE-SIZE, max-number-of-elements=4
    MatrixRowApplication
      element element: category=VALUE, type=uint16, array-size-semantics=FIXED-SIZE, max-number-of-elements=3
    MatrixApplication
      element element: category=TYPE_REFERENCE, type=MatrixRowApplication, array-size-semantics=FIXED-SIZE, max-number-of-elements=2
  application record data type VehicleStateApplication: category=STRUCTURE
    10 x application record element:
      sequence: category=VALUE, type=uint32
      valid: category=VALUE, type=boolean
      mode: category=VALUE, type=uint8
      temperature: category=VALUE, type=float32
      name: category=STRING, type=VehicleNameApplication
      position: category=STRUCTURE, type=PositionApplication
      samples: category=ARRAY, type=SampleWindowApplication
      objects: category=ARRAY, type=ObjectListApplication
      payload: category=ARRAY, type=PayloadBytesApplication
      matrix: category=ARRAY, type=MatrixApplication
  data type mapping set VehicleStateMappings: data-type-map{application-data-type=VehicleStateApplication, implementation-data-type=VehicleState}
package /VLink/SomeipDeployment
  transformation props set VehicleStateTransformationProps
    4 x ap someip transformation props:
      VehicleStateDefaults: alignment=8, byte-order=little-endian, size-of-array-length-field=4, size-of-string-length-field=2, size-of-struct-length-field=2
      FixedArrayWithoutLength: size-of-array-length-field=0
      TwoByteArrayLength: size-of-array-length-field=2
      OneByteArrayLength: size-of-array-length-field=1
  transformation props to service interface element mapping VehicleStateEventDefaults: event=VehicleStateEvent, transformation-props=VehicleStateDefaults
  someip data prototype transformation props SampleWindowDeployment: data-prototypes=VehicleStateEvent.samples, someip-transformation-props=FixedArrayWithoutLength
  someip data prototype transformation props ObjectListDeployment: data-prototypes=VehicleStateEvent.objects, someip-transformation-props=TwoByteArrayLength
  someip data prototype transformation props PayloadBytesDeployment: data-prototypes=VehicleStateEvent.payload, someip-transformation-props=OneByteArrayLength
